## os/Config.in
```kconfig
source "$BR2_EXTERNAL_Q2_PATH/package/q2-probes/Config.in"
source "$BR2_EXTERNAL_Q2_PATH/package/q2-platform/Config.in"
```

## os/configs/q2_defconfig
```kconfig
BR2_mipsel=y
BR2_mips_xburst2_q2=y
# BR2_MIPS_SOFT_FLOAT is not set
BR2_MIPS_FP32_MODE_64=y
BR2_TOOLCHAIN_BUILDROOT_GLIBC=y
BR2_PACKAGE_HOST_LINUX_HEADERS_CUSTOM_6_18=y
BR2_REPRODUCIBLE=y
BR2_GLOBAL_PATCH_DIR="$(BR2_EXTERNAL_Q2_PATH)/patches/packages"
BR2_TIME_BITS_64=y
BR2_JLEVEL=8
BR2_TARGET_GENERIC_HOSTNAME="q2-os"
BR2_TARGET_GENERIC_ISSUE="Q2 source-built OS (emulator development)"
BR2_TARGET_GENERIC_GETTY_PORT="ttyS0"
BR2_TARGET_GENERIC_GETTY_BAUDRATE_115200=y
# BR2_TARGET_GENERIC_REMOUNT_ROOTFS_RW is not set
BR2_ROOTFS_OVERLAY="$(BR2_EXTERNAL_Q2_PATH)/overlay"
BR2_ROOTFS_POST_BUILD_SCRIPT="$(BR2_EXTERNAL_Q2_PATH)/post-build.py"
BR2_PACKAGE_BUSYBOX_CONFIG_FRAGMENT_FILES="$(BR2_EXTERNAL_Q2_PATH)/busybox.fragment"
BR2_PACKAGE_Q2_PROBES=y
BR2_PACKAGE_ALSA_LIB=y
BR2_PACKAGE_ALSA_UTILS=y
BR2_PACKAGE_ALSA_UTILS_APLAY=y
BR2_PACKAGE_DROPBEAR=y
BR2_PACKAGE_DROPBEAR_CLIENT=y
BR2_PACKAGE_DROPBEAR_DISABLE_REVERSEDNS=y
BR2_PACKAGE_CA_CERTIFICATES=y
BR2_TARGET_TZ_INFO=y
BR2_TARGET_TZ_ZONELIST="default"
BR2_TARGET_LOCALTIME="Etc/UTC"
BR2_PACKAGE_DEJAVU=y
BR2_PACKAGE_DEJAVU_SANS=y
BR2_TARGET_ROOTFS_CPIO=y
BR2_TARGET_ROOTFS_CPIO_GZIP=y
BR2_TARGET_ROOTFS_SQUASHFS=y
BR2_TARGET_ROOTFS_SQUASHFS4_XZ=y
BR2_TARGET_ROOTFS_EXT2=y
BR2_TARGET_ROOTFS_EXT2_4=y
BR2_TARGET_ROOTFS_EXT2_SIZE="128M"
# BR2_TARGET_ROOTFS_TAR is not set
BR2_TARGET_ROOTFS_EXT2_LABEL="Q2ROOT"
BR2_TARGET_ROOTFS_EXT2_MKFS_OPTIONS="-U 51324f53-0000-4000-8000-000000000001 -E lazy_itable_init=0,lazy_journal_init=0,hash_seed=51324f53-0000-4000-8000-000000000004"
BR2_TARGET_LDFLAGS="-Wl,-z,noexecstack"
BR2_PACKAGE_Q2_PLATFORM=y
BR2_PACKAGE_KEXEC=y
BR2_PACKAGE_KEXEC_ZLIB=y
BR2_PACKAGE_Q2_EXFAT_FSCK=y
```

## os/package/q2-exfat-fsck/Config.in
```kconfig
config BR2_PACKAGE_Q2_EXFAT_FSCK
	bool "fsck.exfat for the USB card return check"
	depends on BR2_USE_WCHAR
	help
	  fsck.exfat from exfatprogs, alone. os/hardware/usb-storage runs
	  `fsck.exfat -n` on a card whose VolumeDirty flag is set and mounts
	  it read-only when the check fails.
```

## os/package/q2-probes/Config.in
```kconfig
config BR2_PACKAGE_Q2_PROBES
	bool "Q2 ABI and runtime probes"
	depends on BR2_TOOLCHAIN_HAS_THREADS
	select BR2_PACKAGE_ALSA_LIB
	select BR2_PACKAGE_Q2_PLATFORM
```
